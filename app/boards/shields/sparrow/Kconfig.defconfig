## app/boards/shields/sparrow/Kconfig.defconfig
```kconfig
# Copyright (c) 2022 The ZMK Contributors
# SPDX-License-Identifier: MIT

if SHIELD_SPARROW

config ZMK_KEYBOARD_NAME
    default "sparrow"

endif
```

## app/boards/shields/sparrow/Kconfig.shield
```kconfig
# Copyright (c) 2023 The ZMK Contributors
# SPDX-License-Identifier: MIT

config SHIELD_SPARROW
   def_bool $(shields_list_contains,sparrow)
```
